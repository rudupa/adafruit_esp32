## ESP32S3ReverseTFT/esp-idf/main/Kconfig.projbuild
```kconfig
menu "ESP32-S3 Reverse TFT configuration"

config REVTFT_LED_GPIO
    int "Status LED GPIO"
    default 13
    help
        GPIO number wired to the on-board red status LED (Feather pin 13).

config REVTFT_HEARTBEAT_MS
    int "Heartbeat interval (ms)"
    default 250
    help
        Delay between LED toggles and heartbeat log messages.

config REVTFT_SERIAL_BAUD
    int "Serial console baud rate"
    default 115200
    help
        UART baud rate used by the ROM bootloader and ESP-IDF console.

config REVTFT_TFT_H_RES
    int "TFT horizontal resolution"
    default 240
    help
        Pixel width of the on-board ST7789 TFT panel.

config REVTFT_TFT_V_RES
    int "TFT vertical resolution"
    default 135
    help
        Pixel height of the on-board ST7789 TFT panel.

config REVTFT_TFT_COL_OFFSET
    int "TFT column offset"
    default 40
    help
        Column start offset required by the Reverse TFT carrier.

config REVTFT_TFT_ROW_OFFSET
    int "TFT row offset"
    default 53
    help
        Row start offset required by the Reverse TFT carrier.

config REVTFT_TFT_SPI_HZ
    int "TFT SPI clock (Hz)"
    default 40000000
    help
        SPI clock used to refresh the ST7789 panel.

config REVTFT_TFT_POWER_GPIO
    int "TFT power enable GPIO"
    default 7
    help
        GPIO that powers the TFT/I2C rail (TFT_I2C_POWER).

config REVTFT_TFT_BACKLIGHT_GPIO
    int "TFT backlight GPIO"
    default 45
    help
        GPIO controlling the TFT backlight transistor.

config REVTFT_TFT_CS_GPIO
    int "TFT chip select GPIO"
    default 42
    help
        SPI chip-select for the ST7789 panel.

config REVTFT_TFT_DC_GPIO
    int "TFT D/C GPIO"
    default 40
    help
        Data/command select pin for the ST7789.

config REVTFT_TFT_RST_GPIO
    int "TFT reset GPIO"
    default 41
    help
        Hardware reset pin for the ST7789.

config REVTFT_TFT_MOSI_GPIO
    int "TFT MOSI GPIO"
    default 35
    help
        MOSI pin on the dedicated TFT SPI bus.

config REVTFT_TFT_SCLK_GPIO
    int "TFT SCLK GPIO"
    default 36
    help
        Clock pin on the dedicated TFT SPI bus.

endmenu
```

## ESP32S3ReverseTFT/esp-idf/sdkconfig.defaults
```kconfig
CONFIG_IDF_TARGET="esp32s3"
CONFIG_REVTFT_LED_GPIO=13
CONFIG_REVTFT_HEARTBEAT_MS=250
CONFIG_REVTFT_SERIAL_BAUD=115200
CONFIG_ESP_CONSOLE_UART_BAUDRATE=115200
CONFIG_ESPTOOLPY_BAUD=921600
CONFIG_REVTFT_TFT_H_RES=240
CONFIG_REVTFT_TFT_V_RES=135
CONFIG_REVTFT_TFT_COL_OFFSET=40
CONFIG_REVTFT_TFT_ROW_OFFSET=53
CONFIG_REVTFT_TFT_SPI_HZ=40000000
CONFIG_REVTFT_TFT_POWER_GPIO=7
CONFIG_REVTFT_TFT_BACKLIGHT_GPIO=45
CONFIG_REVTFT_TFT_CS_GPIO=42
CONFIG_REVTFT_TFT_DC_GPIO=40
CONFIG_REVTFT_TFT_RST_GPIO=41
CONFIG_REVTFT_TFT_MOSI_GPIO=35
CONFIG_REVTFT_TFT_SCLK_GPIO=36
```

## SparkleMotionMini/esp-idf/main/Kconfig.projbuild
```kconfig
menu "SparkleMotionMini configuration"

config SPARKLE_LED_GPIO
    int "Status LED GPIO"
    default 12
    help
        GPIO number that drives the on-board red LED (labeled 12).

config SPARKLE_HEARTBEAT_MS
    int "Heartbeat interval (ms)"
    default 500
    help
        Delay between LED toggles and heartbeat log messages.

config SPARKLE_SERIAL_BAUD
    int "Serial console baud rate"
    default 115200
    help
        UART baud rate used by the ROM bootloader and ESP-IDF console.

endmenu
```

## SparkleMotionMini/esp-idf/sdkconfig.defaults
```kconfig
CONFIG_IDF_TARGET="esp32"
CONFIG_SPARKLE_LED_GPIO=12
CONFIG_SPARKLE_HEARTBEAT_MS=500
CONFIG_SPARKLE_SERIAL_BAUD=115200
CONFIG_ESP_CONSOLE_UART_BAUDRATE=115200
CONFIG_ESPTOOLPY_BAUD=921600
```
